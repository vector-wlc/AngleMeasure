/*
 * @coding: utf-8
 * @Author: vector-wlc
 * @Date: 2020-05-26 10:47:50
 * @Description: 
 */

#include "oled.h"

/************************************6*8的点阵************************************/
const uint8_t F6x8[][6] =
    {
        {0x00, 0x3E, 0x51, 0x49, 0x45, 0x3E}, // 0  0
        {0x00, 0x00, 0x42, 0x7F, 0x40, 0x00}, // 1  1
        {0x00, 0x42, 0x61, 0x51, 0x49, 0x46}, // 2  2
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        {0x00, 0x00, 0x00, 0x00, 0x00, 0x00}  // space 37
};

void Oled::writeCmd(uint8_t cmd)
{
    WriteByte(OLED_CMD, cmd);
}

void Oled::writeData(uint8_t data)
{
    WriteByte(OLED_DATA, data);
}

void Oled::setPos(uint8_t row, uint8_t col)
{
    writeCmd(0xb0 + ((row >> 3) & 0xf));
    writeCmd(((col & 0xf0) >> 4) | 0x10);
    writeCmd((col & 0x0f) | 0x01);
}

Oled::Oled(uint8_t _port, uint8_t _scl_pos, uint8_t _sda_pos)
{
    LoadPort(_port, _scl_pos, _sda_pos, OLED_ADDRESS);
    SetPortLevel();
    SetDelayTime(5);
    uint8_t init_cmd[] =
        {// OLED 初始化命令
         0xAE, 0x00, 0x10, 0x40, 0xB0, 0x81, 0xFF, 0xA1, 0xA6, 0xA8, 0x3F,

         0xC8, 0xD3, 0x00, 0xD5, 0x80, 0xD8, 0x05, 0xD9, 0xF1, 0xDA, 0x12,

         0xD8, 0x30, 0x8D, 0x14, 0xAF};

    for (uint8_t i = 0; i < 27; ++i)
    {
        writeCmd(init_cmd[i]);
    }
}

void Oled::ClearAll()
{
    uint8_t row = 0;
    uint8_t col = 0;
    for (row = 0; row < 8; ++row)
    {
        writeCmd(0xB0 + row);
        writeCmd(0x00);
        writeCmd(0x10);
        for (col = 0; col < 128; ++col)
        {
            writeData(0x00);
        }
    }
}

void Oled::ClearRow(uint8_t row)
{
    uint8_t col;
    writeCmd(0xB0 + row);
    writeCmd(0x00);
    writeCmd(0x10);
    for (col = 0; col < 128; ++col)
    {
        writeData(0x00);
    }
}

void Oled::DisplayOn()
{
    writeCmd(0X8D); //SET DCDC命令
    writeCmd(0X14); //DCDC ON
    writeCmd(0XAF); //DISPLAY ON
}

void Oled::DisplayOff()
{
    writeCmd(0X8D); //SET DCDC命令
    writeCmd(0X10); //DCDC OFF
    writeCmd(0XAE); //DISPLAY OFF
}

void Oled::ShowChar(uint8_t row, uint8_t col, uint8_t ch)
{
    uint8_t index = 0;
    // 进行字符与数组索引的转换
    if (ch >= '0' && ch <= '9')
    {
        index = ch - '0';
    }
    else if (ch >= 'a' && ch <= 'z')
    {
        index = ch - 'a' + 11;
    }
    else if (ch == ':')
    {
        index = 10;
    }
    else
    {
        index = 37;
    }
    setPos(row, col);
    for (uint8_t i = 0; i < 6; ++i)
    {
        writeData(F6x8[index][i]);
    }
}

// 显示字符串
void Oled::ShowStr(uint8_t row, uint8_t col, const uint8_t *str)
{
    while (*str)
    {
        ShowChar(row, col, *str);
        col += 8;
        if (col > 120)
        {
            col = 0;
            row += 8;
        }
        ++str;
    }
}

void Oled::ShowNum(uint8_t row, uint8_t col, uint8_t num)
{
    uint8_t str[4]; // 最多三位数
    sprintf((char *)str, "%d", num);
    ShowStr(row, col, str);
}